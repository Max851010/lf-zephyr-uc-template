## west.yml
```yaml
# Copyright (c) 2023 <erling.r.jellum@ntnu.no>
# Template manifest file for Lingua Franca zephyr projects

manifest:
  self:
    west-commands: scripts/west-commands.yml
    path: .

  remotes:
    - name: zephyrproject-rtos
      url-base: https://github.com/zephyrproject-rtos

  projects:
    - name: zephyr
      remote: zephyrproject-rtos
      revision: v3.7.0
      import: 
        path-prefix: deps
    - name: HX711
      path: modules/HX711
      url: https://github.com/nobodyguy/HX711_zephyr_driver
      revision: refs/tags/zephyr-v3.3.0
```
